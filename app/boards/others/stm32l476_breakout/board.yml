## app/boards/others/stm32l476_breakout/board.yml
```yaml
board:
  name: stm32l476_breakout
  vendor: others
  socs:
    - name: stm32l476xx
```

## app/boards/others/stm32l476_breakout/stm32l476_breakout_defconfig
```kconfig
# SPDX-License-Identifier: Apache-2.0

# enable uart driver
CONFIG_SERIAL=y
CONFIG_UART_INTERRUPT_DRIVEN=y

# enable GPIO
CONFIG_GPIO=y

# enable clock
CONFIG_CLOCK_CONTROL=y

# console
CONFIG_CONSOLE=y
CONFIG_UART_CONSOLE=y

# enable MPU
CONFIG_ARM_MPU=y

# Enable HW stack protection
CONFIG_HW_STACK_PROTECTION=y

# enable pin controller
CONFIG_PINCTRL=y

# Move the video buffer to fill the 32k SRAM2 block.
# imported from synth project
CONFIG_LV_Z_VBD_CUSTOM_SECTION=y
CONFIG_LV_Z_VDB_SIZE=14
```

## app/boards/stm32l476_breakout/Kconfig.stm32l476_breakout
```kconfig
# Copyright (c) 2017 Linaro Limited
# SPDX-License-Identifier: Apache-2.0

config BOARD_STM32L476_BREAKOUT
	select SOC_STM32L476XX
```

## app/boards/stm32l476_breakout/board.yml
```yaml
board:
  name: stm32l476_breakout
  vendor: st
  socs:
    - name: stm32l476xx
# idk if I should put st as the vendor
```
